## Kconfig.projbuild
```kconfig
menu "Charger Settings"
    config CHARGER_WIFI_SSID
        string "WiFi SSID"
        default "Wokwi-GUEST"
    config CHARGER_WIFI_PASS
        string "WiFi Password"
        default ""
endmenu
```
